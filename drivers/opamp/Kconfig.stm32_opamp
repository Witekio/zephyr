## drivers/opamp/Kconfig.stm32_opamp
```kconfig
# Copyright (c) 2025 Alexander Kozhinov <ak.alexander.kozhinov@gmail.com>
# Copyright (c) 2026 Witekio
# SPDX-License-Identifier: Apache-2.0

config OPAMP_STM32
	bool "STM32 OPAMP driver"
	default y
	select PINCTRL
	depends on DT_HAS_ST_STM32_OPAMP_ENABLED && !DT_HAS_ST_STM32U5_OPAMP_ENABLED

config OPAMP_STM32_U5
	bool "STM32U5 OPAMP driver"
	default y
	select PINCTRL
	depends on DT_HAS_ST_STM32U5_OPAMP_ENABLED
```

## dts/bindings/opamp/st,stm32u5-opamp.yaml
~~~~yaml
# Copyright (c) 2026 Witekio
# SPDX-License-Identifier: Apache-2.0

title: STM32U5 OPAMP (Operational Amplifier)

description: |
  The STM32U5 series embeds two operational amplifiers (OPAMP1 and OPAMP2)
  with two inputs and one output each. The three I/Os can be connected to
  external pins, enabling any type of external interconnection.
  An OPAMP can be configured internally:
    - standalone amplifier (external gain setting mode)
    - follower
    - non-inverting amplifier with gains of 2, 4, 8 or 16

  Inverting and differential functional modes are not supported by the
  hardware.

  The non-inverting input can be connected to the internal DAC
  (DAC1 channel 1 for OPAMP1, DAC1 channel 2 for OPAMP2).

  Input and output pins (RM0456, Table 363):
    - OPAMP1: VINP0 = PA0, VINM0 = PA1, VOUT = PA3
    - OPAMP2: VINP0 = PA6, VINM0 = PA7, VOUT = PB0
    - VINM1 is the dedicated low-leakage input, available on BGA132,
      BGA169 and BGA216 packages only.

  Minimal DTS examples for OPAMP2:

    - Standalone amplifier (external gain):
      ```
      &opamp2 {
        pinctrl-0 = <&opamp2_vinm_pa7 &opamp2_vinp_pa6 &opamp2_vout_pb0>;
        pinctrl-names = "default";
        functional-mode = "standalone";
        inp = "VINP0";
        inm = "VINM0";
        status = "okay";
      };
      ```

    - Follower (voltage buffer) of the DAC output:
      ```
      &opamp2 {
        pinctrl-0 = <&opamp2_vout_pb0>;
        pinctrl-names = "default";
        functional-mode = "follower";
        inp = "DAC";
        status = "okay";
      };
      ```

    - Non-inverting PGA (gain 2..16):
      ```
      &opamp2 {
        pinctrl-0 = <&opamp2_vinp_pa6 &opamp2_vout_pb0>;
        pinctrl-names = "default";
        functional-mode = "non_inverting";
        inp = "VINP0";
        status = "okay";
      };
      ```

  References:
    - RM0456, chapter "Operational amplifier (OPAMP)":
      https://www.st.com/resource/en/reference_manual/rm0456-stm32u5-series-armbased-32bit-mcus-stmicroelectronics.pdf

include:
  - st,stm32-opamp.yaml

compatible: st,stm32u5-opamp

properties:
  st,power-mode:
    type: string
    description: |
      OPAMP power mode, selected by the OPALPM and OPAHSM bits of OPAMPx_CSR:
        - NORMALPOWER_NORMALSPEED: normal mode, standard slew rate.
        - LOWPOWER_NORMALSPEED: low-power mode, standard slew rate.
        - NORMALPOWER_HIGHSPEED: normal mode, increased consumption to
          improve the slew rate.
        - LOWPOWER_HIGHSPEED: low-power mode, increased consumption to
          improve the slew rate.
      Normal and low-power modes use separate trimming values (OPAMPx_OTR
      and OPAMPx_LPOTR). Refer to the device datasheet for the slew rate,
      bandwidth and consumption of each mode.
    enum:
      - NORMALPOWER_NORMALSPEED
      - LOWPOWER_NORMALSPEED
      - NORMALPOWER_HIGHSPEED
      - LOWPOWER_HIGHSPEED
    default: NORMALPOWER_NORMALSPEED

  st,enable-self-calibration:
    type: boolean
    description: |
      Run the offset self-calibration of the NMOS and PMOS differential pairs
      at OPAMP initialization, for the selected power mode.
      See RM0456, OPAMP calibration section.

  inp:
    required: true
    type: string
    description: |
      Non-inverting input selection (VP_SEL bit of OPAMPx_CSR):
        - VINP0: GPIO pin
        - DAC: DAC1 channel 1 for OPAMP1, DAC1 channel 2 for OPAMP2
      See RM0456, Table 363.
    enum:
      - VINP0
      - DAC

  inm:
    type: string
    description: |
      Inverting input selection (VM_SEL bits of OPAMPx_CSR):
        - VINM0: GPIO pin
        - VINM1: dedicated low-leakage input
      Required in standalone mode. In non_inverting (PGA) mode it is optional
      and connects the selected pin to the internal feedback node for
      low-pass filtering. Leave unset to keep the inverting input not
      externally connected. Ignored in follower mode.
      See RM0456, Table 363 and the PGA mode description.
    enum:
      - VINM0
      - VINM1

  st,pmos-trimming-value:
    type: int
    description: |
      OPAMP PMOS differential pair offset trimming value, written to
      TRIMOFFSETP[4:0] of OPAMPx_OTR in normal mode or TRIMLPOFFSETP[4:0] of
      OPAMPx_LPOTR in low-power mode, as selected by st,power-mode.
      If present together with st,enable-self-calibration, this value
      overrides the one found by self-calibration.
      See RM0456, OPAMPx_OTR and OPAMPx_LPOTR register descriptions.
    min: 0
    max: 0x1f

  st,nmos-trimming-value:
    type: int
    description: |
      OPAMP NMOS differential pair offset trimming value, written to
      TRIMOFFSETN[4:0] of OPAMPx_OTR in normal mode or TRIMLPOFFSETN[4:0] of
      OPAMPx_LPOTR in low-power mode, as selected by st,power-mode.
      If present together with st,enable-self-calibration, this value
      overrides the one found by self-calibration.
      See RM0456, OPAMPx_OTR and OPAMPx_LPOTR register descriptions.
    min: 0
    max: 0x1f
~~~~
